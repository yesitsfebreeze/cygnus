## boards/shields/cyg/Kconfig.defconfig
```kconfig
if SHIELD_CORNE_RIGHT

config ZMK_KEYBOARD_NAME
    default "Cygnus"

config ZMK_SPLIT_ROLE_CENTRAL
    default y

endif

if SHIELD_CYG_LEFT || SHIELD_CYG_RIGHT

config ZMK_SPLIT
    default y

endif
```

## boards/shields/cyg/Kconfig.shield
```kconfig
config SHIELD_CYG_LEFT
    def_bool $(shields_list_contains,cyg_left)

config SHIELD_CYG_RIGHT
    def_bool $(shields_list_contains,cyg_right)
```

## config/boards/shields/cygnus/KConfig.shield
```kconfig
config SHIELD_CYGNUS_LEFT
	def_bool $(shield_list_contains, cygnus_left)

config SHIELD_CYGNUS_RIGHT
	def_bool $(shield_list_contains, cygnus_right)
	
```

## config/boards/shields/cygnus/Kconfig.defconfig
```kconfig
if SHIELD_CYGNUS_LEFT

config ZMK_BATTERY_REPORTING
	default n

config ZMK_KEYBOARD_NAME
	default "cygnus"

config ZMK_SPLIT_ROLE_CENTRAL
	default y

endif

if SHIELD_CYGNUS_LEFT || SHIELD_CYGNUS_RIGHT

config ZMK_SPLIT
	default y
endif
```

## config/boards/shields/cygnus/Kconfig.shield
```kconfig
config SHIELD_cygnus_LEFT
	def_bool $(shields_list_contains,cygnus_left)

config SHIELD_cygnus_RIGHT
	def_bool $(shields_list_contains,cygnus_right)
```

## config/west.yml
```yaml
manifest:
  projects:
    - name: zmk
      remote: zmkfirmware
      revision: main
      import: app/west.yml
  self:
    path: config
```
